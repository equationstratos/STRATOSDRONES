/* PMW3901MB optical flow sensor driver (SPI, mode 3, <=2 MHz).
 * Init/performance register sequence per PixArt PMW3901MB datasheet section
 * "Performance Optimization Registers" (factual register list).
 * SPDX-License-Identifier: MIT */
#include "driver/spi_master.h"
#include "drivers.h"
#include "esp_log.h"
#include "freertos/FreeRTOS.h"

static const char *TAG = "pmw3901";
extern spi_device_handle_t g_spi_flow;
esp_err_t spi_reg_write(spi_device_handle_t dev, uint8_t reg, uint8_t val);
esp_err_t spi_reg_read(spi_device_handle_t dev, uint8_t reg, uint8_t *buf, size_t n);

#define REG_PRODUCT_ID 0x00 /* = 0x49 */
#define REG_MOTION     0x02
#define REG_POWER_UP   0x3A

static void wr(uint8_t r, uint8_t v) { spi_reg_write(g_spi_flow, r, v); }

static void perf_init(void)
{
    /* PixArt-documented optimization sequence */
    wr(0x7F, 0x00); wr(0x61, 0xAD); wr(0x7F, 0x03); wr(0x40, 0x00);
    wr(0x7F, 0x05); wr(0x41, 0xB3); wr(0x43, 0xF1); wr(0x45, 0x14);
    wr(0x5B, 0x32); wr(0x5F, 0x34); wr(0x7B, 0x08); wr(0x7F, 0x06);
    wr(0x44, 0x1B); wr(0x40, 0xBF); wr(0x4E, 0x3F); wr(0x7F, 0x08);
    wr(0x65, 0x20); wr(0x6A, 0x18); wr(0x7F, 0x09); wr(0x4F, 0xAF);
    wr(0x5F, 0x40); wr(0x48, 0x80); wr(0x49, 0x80); wr(0x57, 0x77);
    wr(0x60, 0x78); wr(0x61, 0x78); wr(0x62, 0x08); wr(0x63, 0x50);
    wr(0x7F, 0x0A); wr(0x45, 0x60); wr(0x7F, 0x00); wr(0x4D, 0x11);
    wr(0x55, 0x80); wr(0x74, 0x21); wr(0x75, 0x1F); wr(0x4A, 0x78);
    wr(0x4B, 0x78); wr(0x44, 0x08); wr(0x45, 0x50); wr(0x64, 0xFF);
    wr(0x65, 0x1F); wr(0x7F, 0x14); wr(0x65, 0x67); wr(0x66, 0x08);
    wr(0x63, 0x70); wr(0x7F, 0x15); wr(0x48, 0x48); wr(0x7F, 0x07);
    wr(0x41, 0x0D); wr(0x43, 0x14); wr(0x4B, 0x0E); wr(0x45, 0x0F);
    wr(0x44, 0x42); wr(0x4C, 0x80); wr(0x7F, 0x10); wr(0x5B, 0x02);
    wr(0x7F, 0x07); wr(0x40, 0x41); wr(0x70, 0x00);
    vTaskDelay(pdMS_TO_TICKS(10));
    wr(0x32, 0x44); wr(0x7F, 0x07); wr(0x40, 0x40); wr(0x7F, 0x06);
    wr(0x62, 0xF0); wr(0x63, 0x00); wr(0x7F, 0x0D); wr(0x48, 0xC0);
    wr(0x6F, 0xD5); wr(0x7F, 0x00); wr(0x5B, 0xA0); wr(0x4E, 0xA8);
    wr(0x5A, 0x50); wr(0x40, 0x80);
}

esp_err_t pmw3901_init(void)
{
    wr(REG_POWER_UP, 0x5A); /* power-up reset */
    vTaskDelay(pdMS_TO_TICKS(5));
    uint8_t id = 0, inv = 0;
    spi_reg_read(g_spi_flow, REG_PRODUCT_ID, &id, 1);
    spi_reg_read(g_spi_flow, 0x5F, &inv, 1); /* inverse product id = 0xB6 */
    if (id != 0x49 || inv != 0xB6) {
        ESP_LOGE(TAG, "id=0x%02x inv=0x%02x (want 0x49/0xB6)", id, inv);
        return ESP_ERR_NOT_FOUND;
    }
    /* drain first motion regs after reset */
    uint8_t dump;
    for (uint8_t r = 0x02; r <= 0x06; r++) spi_reg_read(g_spi_flow, r, &dump, 1);
    perf_init();
    ESP_LOGI(TAG, "ready");
    return ESP_OK;
}

esp_err_t pmw3901_read(flow_sample_t *out)
{
    /* motion burst: MOTION, OBS, DX_L, DX_H, DY_L, DY_H, SQUAL, ... */
    uint8_t b[7];
    esp_err_t err = spi_reg_read(g_spi_flow, 0x16, b, sizeof(b));
    if (err != ESP_OK) return err;
    out->dx = (int16_t)((b[3] << 8) | b[2]);
    out->dy = (int16_t)((b[5] << 8) | b[4]);
    out->squal = b[6];
    return ESP_OK;
}
